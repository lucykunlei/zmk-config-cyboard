## config/boards/shields/cyboard/Kconfig.defconfig
```kconfig
if SHIELD_CYBOARD_LEFT

config ZMK_KEYBOARD_NAME
    default "LL's Imprint"

config ZMK_SPLIT_ROLE_CENTRAL
    default y

endif

if SHIELD_CYBOARD_LEFT || SHIELD_CYBOARD_RIGHT

config ZMK_SPLIT
    default y

endif
```
